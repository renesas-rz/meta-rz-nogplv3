## conf/layer.conf
```bitbake
# We have a conf and classes directory, add to BBPATH
BBPATH .= ":${LAYERDIR}"

# We have recipes-* directories, add to BBFILES
BBFILES += "${LAYERDIR}/recipes-*/*/*.bb \
            ${LAYERDIR}/recipes-*/*/*.bbappend \
           "

BBFILE_COLLECTIONS += "meta-rz-nogplv3"
BBFILE_PATTERN_meta-rz-nogplv3 := "^${LAYERDIR}/"

LAYERDEPENDS_meta-rz-nogplv3 = "meta-rz-bsp"
LAYERSERIES_COMPAT_meta-rz-nogplv3 = "scarthgap"

include ${LAYERDIR}/include/rz-nogplv3.inc
```
